## board/mohism/boot.its
```
// SPDX-License-Identifier: (GPL-2.0+ OR MIT)
/dts-v1/;
/ {
 description = "MOHISM RV1106G3 Linux";
 #address-cells = <1>;
 images {
  kernel {
   description = "Linux 5.10.160 zImage";
   data = /incbin/("zImage");
   type = "kernel";arch = "arm";os = "linux";compression = "none";
   load = <0x02008000>;entry = <0x02008000>;
   hash {algo = "sha256";};
  };
  fdt {
   description = "RV1106G3-VINS EDA board";
   data = /incbin/("rv1106g3-mohism-vins.dtb");
   type = "flat_dt";arch = "arm";compression = "none";
   load = <0x03000000>;
   hash {algo = "sha256";};
  };
 };
 configurations {
  default = "conf";
  conf {description = "MOHISM";kernel = "kernel";fdt = "fdt";};
 };
};
```

## buildroot/external/Config.in
```kconfig
source "$BR2_EXTERNAL_MOHISM_PATH/package/mohism-ceres/Config.in"
source "$BR2_EXTERNAL_MOHISM_PATH/package/mohism-vins/Config.in"
```

## buildroot/external/configs/mohism_rv1106_defconfig
```kconfig
BR2_arm=y
BR2_cortex_a7=y
BR2_ARM_FPU_NEON_VFPV4=y
BR2_TOOLCHAIN_EXTERNAL=y
BR2_TOOLCHAIN_EXTERNAL_CUSTOM=y
BR2_TOOLCHAIN_EXTERNAL_PATH="$(BR2_EXTERNAL_MOHISM_PATH)/../../vendor/luckfox-pico/tools/linux/toolchain/arm-rockchip830-linux-uclibcgnueabihf"
BR2_TOOLCHAIN_EXTERNAL_CUSTOM_PREFIX="arm-rockchip830-linux-uclibcgnueabihf"
BR2_TOOLCHAIN_EXTERNAL_GCC_8=y
BR2_TOOLCHAIN_EXTERNAL_HEADERS_5_10=y
BR2_TOOLCHAIN_EXTERNAL_WCHAR=y
BR2_TOOLCHAIN_EXTERNAL_HAS_SSP=y
BR2_TOOLCHAIN_EXTERNAL_CXX=y
BR2_TARGET_OPTIMIZATION="-O2 -pipe"
BR2_PRIMARY_SITE="https://sources.buildroot.net"
BR2_WGET="wget --passive-ftp -nd -t 2 -T 20"
BR2_TARGET_GENERIC_HOSTNAME="mohism-vins"
BR2_TARGET_GENERIC_ISSUE="MOHISM stereo VINS development firmware"
BR2_TARGET_GENERIC_GETTY_PORT="ttyS2"
BR2_ROOTFS_DEVICE_CREATION_DYNAMIC_DEVTMPFS=y
BR2_ROOTFS_OVERLAY="$(BR2_EXTERNAL_MOHISM_PATH)/../../board/mohism/rootfs-overlay"
BR2_ROOTFS_POST_BUILD_SCRIPT="$(BR2_EXTERNAL_MOHISM_PATH)/../../scripts/post-build.sh"
BR2_PACKAGE_BUSYBOX_CONFIG_FRAGMENT_FILES="$(BR2_EXTERNAL_MOHISM_PATH)/../../board/mohism/busybox.config"
BR2_PACKAGE_MOHISM_VINS=y
BR2_PACKAGE_LIBV4L=y
BR2_PACKAGE_LIBV4L_UTILS=y
BR2_PACKAGE_I2C_TOOLS=y
BR2_PACKAGE_KMOD=y
BR2_PACKAGE_KMOD_TOOLS=y
BR2_PACKAGE_HOST_KMOD=y
BR2_PACKAGE_RT_TESTS=y
BR2_PACKAGE_OPENCV4_LIB_CALIB3D=y
BR2_PACKAGE_OPENCV4_LIB_IMGPROC=y
BR2_PACKAGE_OPENCV4_LIB_IMGCODECS=y
BR2_PACKAGE_OPENCV4_LIB_VIDEO=y
# BR2_PACKAGE_OPENCV4_LIB_DNN is not set
# BR2_PACKAGE_OPENCV4_LIB_HIGHGUI is not set
# BR2_PACKAGE_OPENCV4_LIB_VIDEOIO is not set
# BR2_PACKAGE_OPENCV4_WITH_IPP is not set
BR2_TARGET_ROOTFS_EXT2=y
BR2_TARGET_ROOTFS_EXT2_4=y
BR2_TARGET_ROOTFS_EXT2_SIZE="256M"
# BR2_TARGET_ROOTFS_TAR is not set
```

## buildroot/external/package/mohism-ceres/Config.in
```kconfig
config BR2_PACKAGE_MOHISM_CERES
	bool "mohism-ceres"
	depends on BR2_INSTALL_LIBSTDCPP
	depends on BR2_TOOLCHAIN_HAS_THREADS
	select BR2_PACKAGE_EIGEN
	help
	  Pinned Ceres solver for the stereo-inertial sliding window and pose graph.
```

## buildroot/external/package/mohism-vins/Config.in
```kconfig
config BR2_PACKAGE_MOHISM_VINS
	bool "mohism-vins"
	depends on BR2_INSTALL_LIBSTDCPP
	depends on BR2_USE_WCHAR
	select BR2_PACKAGE_OPENCV4
	select BR2_PACKAGE_MOHISM_CERES
	select BR2_PACKAGE_OPENCV4_LIB_FEATURES2D
	select BR2_PACKAGE_OPENCV4_LIB_CALIB3D
	select BR2_PACKAGE_OPENCV4_LIB_IMGPROC
	select BR2_PACKAGE_OPENCV4_LIB_IMGCODECS
	select BR2_PACKAGE_OPENCV4_LIB_VIDEO
	help
	  Stereo depth, tightly coupled visual-inertial optimizer, UVC and MAVLink service.
```
